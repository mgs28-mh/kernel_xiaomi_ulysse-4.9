## drivers/input/touchscreen/ft5435_ulysse/Kconfig
```kconfig
#
# Focaltech Touchscreen driver configuration
#

config TOUCHSCREEN_FT5435_ULYSSE
		bool "Focaltech Touchscreen"
		depends on I2C
		default n
		help
		  Say Y here if you have Focaltech touch panel.
		  If unsure, say N.

config TOUCHSCREEN_FT5435_ULYSSE_DIRECTORY
	string "Focaltech ts directory name"
	default "focaltech_touch"
	depends on TOUCHSCREEN_FT5435_ULYSSE
```

## drivers/platform/xiaomi/Kconfig
```kconfig
config MACH_XIAOMI_ULYSSE
	bool "Xiaomi Redmi Note 5A (Unified)"
	depends on ARCH_MSM8917
	depends on ARCH_MSM8940
	help
	  Support for Xiaomi Redmi Note 5A (Unified).
```
